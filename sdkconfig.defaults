## sdkconfig.defaults
```kconfig
# Auto-detect crystal frequency
CONFIG_ESP32_XTAL_FREQ_AUTO=y
CONFIG_ESP32_XTAL_FREQ=0

# Enable BLE
CONFIG_BT_ENABLED=y
CONFIG_SCAN_DUPLICATE_BY_ADV_DATA_AND_DEVICE_ADDR=y
BT_ALLOCATION_FROM_SPIRAM_FIRST=y
BT_BLE_DYNAMIC_ENV_MEMORY=y
CONFIG_BT_STACK_NO_LOG=y

# Give BLE higher default priority than Wi-Fi
CONFIG_SW_COEXIST_ENABLE=y
CONFIG_SW_COEXIST_PREFERENCE_BT=y
CONFIG_SW_COEXIST_PREFERENCE_VALUE=1

# Task watchdog & reboot settings
CONFIG_TASK_WDT_PANIC=y
CONFIG_ESP32_PANIC_SILENT_REBOOT=y

# Specify custom partitions (app requires higher memory allocation than default)
CONFIG_PARTITION_TABLE_CUSTOM=y
CONFIG_PARTITION_TABLE_CUSTOM_FILENAME="partitions.csv"
CONFIG_PARTITION_TABLE_CUSTOM_APP_BIN_OFFSET=0x10000
CONFIG_PARTITION_TABLE_FILENAME="partitions.csv"
CONFIG_APP_OFFSET=0x10000

# Rock that baudy
CONFIG_CONSOLE_UART_BAUDRATE=921600
CONFIG_MONITOR_BAUD_921600B=y

# Disable log output
CONFIG_LOG_BOOTLOADER_LEVEL=0
CONFIG_LOG_DEFAULT_LEVEL=0
CONFIG_BT_STACK_NO_LOG=y
```
